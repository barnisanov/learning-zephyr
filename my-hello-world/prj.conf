## CMakeLists.txt
```
# SPDX-License-Identifier: Apache-2.0

cmake_minimum_required(VERSION 3.20.0)

set(BOARD nucleo_f070rb)

find_package(Zephyr REQUIRED HINTS $ENV{ZEPHYR_BASE})
project(hello_world)

target_sources(app PRIVATE src/main.c)
```

## prj.conf
```kconfig
# Allows logging
CONFIG_LOG=y
CONFIG_LOG_BACKEND_UART=y
# Allows logging through UART console
CONFIG_UART_CONSOLE=y
CONFIG_CONSOLE=y
# Allows debugging via RTT
CONFIG_USE_SEGGER_RTT=y
CONFIG_RTT_CONSOLE=y
# CONFIG_LOG_BACKEND_RTT=y
```

## src/main.c
```c
#include <stdio.h>
#include "zephyr/kernel.h"

int main(void)
{
    while (true)
    {
        printk("hello world\n");
        k_msleep(1000);
    }

    return 0;
}
```
